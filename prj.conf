## CMakeLists.txt
```
cmake_minimum_required(VERSION 3.20.0)

find_package(Zephyr REQUIRED HINTS $ENV{ZEPHYR_BASE})
project(uwb-cat-tracker)

target_sources(app PRIVATE 
    src/main.c
    src/deca_port.c
    src/dw1000_config.c
    src/uwb_radio.c
    src/initiator.c
    src/responder.c
    src/storage.c
    src/cmds.c
    vendor/decadriver/deca_device.c
	vendor/decadriver/deca_params_init.c
)

target_include_directories(app PRIVATE
	src
	vendor/decadriver
)
```

## Kconfig
```
menu "UWB cat tracker"

choice
    prompt "Node role"
    default UWB_ROLE_INITIATOR

config UWB_ROLE_INITIATOR
    bool "Initiator - sends poll, waits for response"

config UWB_ROLE_RESPONDER
    bool "Responder - waits for poll, replies"

endchoice

config UWB_DUMP_INFO
    bool "Print OTP calibration data at startup"
    default n
    help
        Reads PART_ID, LOT_ID, crystal trim, antenna delay and TX
	    power from OTP and prints them. Used to fill in
	    docs/modules.md when a new module is added.

endmenu

source "Kconfig.zephyr"
```

## prj.conf
```kconfig
CONFIG_LOG=y
# Deferred mode: synchronous printing blocks the calling thread for
# milliseconds and would wreck the ranging timestamps. The responder
# calls k_msleep(1) after each reply so the log thread gets a slot.
CONFIG_LOG_MODE_DEFERRED=y

# Logs go to RTT, not to the UART. RTT writes into a ring buffer in
# the chip's own RAM, which the on-board J-Link reads over SWD, so
# output survives until a host connects instead of being lost when
# nothing is listening. It is also far faster than 115200 baud,
# which matters because every log call sits inside the T_reply this
# project measures.
CONFIG_LOG_BACKEND_RTT=y
CONFIG_LOG_BACKEND_UART=n

# 1 KB holds only about six statistics lines; 4 KB covers a full
# warm-up run, so the board can be left alone and read later.
CONFIG_SEGGER_RTT_BUFFER_SIZE_UP=4096

CONFIG_SEGGER_RTT_INIT_MODE_ALWAYS=y

# The shell's own log backend is off as well: with it on, every
# message is printed a second time into the shell terminal and
# collides with whatever is being typed there.
CONFIG_SHELL_LOG_BACKEND=n

CONFIG_SPI=y
CONFIG_GPIO=y

# Persistent per-node configuration: antenna delay, and later the
# node role and id. FLASH_PAGE_LAYOUT is a dependency of NVS;
# FLASH_MAP provides PARTITION_DEVICE and PARTITION_OFFSET.
CONFIG_FLASH=y
CONFIG_FLASH_PAGE_LAYOUT=y
CONFIG_FLASH_MAP=y
CONFIG_NVS=y

# Interactive shell on the UART, which is now free of log output:
# the address and antenna delay can be written from the board
# instead of being burned in at build time.
CONFIG_SHELL=y
```

## info.conf
```kconfig
CONFIG_UWB_DUMP_INFO=y
```

## initiator.conf
```kconfig
CONFIG_UWB_ROLE_INITIATOR=y
```

## responder.conf
```kconfig
CONFIG_UWB_ROLE_RESPONDER=y
```

## rx.conf
```kconfig
CONFIG_UWB_ROLE_RX=y
```

## tx.conf
```kconfig
CONFIG_UWB_ROLE_TX=y
```

## src/main.c
```c
#include <stdint.h>
#include <sys/errno.h>
#include <zephyr/kernel.h>
#include <zephyr/logging/log.h>

#include "deca_device_api.h"
#include "deca_port.h"
#include "dw1000_config.h"
#include "initiator.h"
#include "responder.h"
#include "deca_regs.h"
#include "storage.h"
#include "uwb_msg.h"

LOG_MODULE_REGISTER(main, LOG_LEVEL_INF);

uint16_t uwb_my_addr;

#if defined (CONFIG_UWB_DUMP_INFO)
static void dump_device_info(void) {
    uint32 otp[5];
    uint8 xtalt;

    dwt_otpread(0x006, &otp[0], 1);   /* PART_ID   */
	dwt_otpread(0x007, &otp[1], 1);   /* LOT_ID    */
	dwt_otpread(0x019, &otp[2], 1);   /* CH5 TX power, PRF 64 */
	dwt_otpread(0x01C, &otp[3], 1);   /* antenna delay */
	dwt_otpread(0x01E, &otp[4], 1);   /* XTAL_TRIM */

	dwt_readfromdevice(0x2B, 0x0E, 1, &xtalt);

    LOG_INF("PART_ID    0x%08X", otp[0]);
	LOG_INF("LOT_ID     0x%08X", otp[1]);
	LOG_INF("XTAL_TRIM  %u  (FS_XTALT 0x%02X)", otp[4] & 0x1F, xtalt);
	LOG_INF("ANT_DELAY  %u (OTP)", otp[3] >> 16);
	LOG_INF("TX_POWER   0x%08X (OTP)", otp[2]);
	LOG_INF("TX_POWER   0x%08X (register, before configure)", dwt_read32bitreg(TX_POWER_ID));
}
#endif

static int dw1000_setup(void)
{
    uint16_t ant_dly;

    if (storage_init() != 0) {
        return  -EIO;
    }

    uwb_my_addr = storage_get_addr();

    storage_set_ant_dly(16430);   /* temporary: verifying the model */

    ant_dly = storage_get_ant_dly();

	if (deca_port_init() != 0) {
		return -ENODEV;
	}

	reset_DW1000();
	port_set_dw1000_slowrate();

	if (dwt_initialise(DWT_LOADUCODE) == DWT_ERROR) {
		LOG_ERR("dwt_initialise failed");
		return -EIO;
	}

    /* OTP must be read at the slow SPI rate. At 8 MHz the reads
	 * return 0xFF and leave the OTP interface hung. */
	uint32 tx_power;
	dwt_otpread(0x019, &tx_power, 1);   /* channel 5, PRF 64 */

#if defined(CONFIG_UWB_DUMP_INFO)
    dump_device_info();
#endif

	port_set_dw1000_fastrate();
    
    dwt_configure((dwt_config_t *)&dw1000_config);

    /* Push frame filtering into the chip: only data frames
     * addressed to us (or broadcast) reach the RX buffer, instead
     * of software sorting everything that arrives on air. */
    dwt_setpanid(UWB_PAN);
    dwt_setaddress16(uwb_my_addr);
    dwt_enableframefilter(DWT_FF_DATA_EN);

    /* dwt_configure() does not touch TX_POWER; without this the
	 * chip keeps its reset default instead of the factory
	 * calibration held in OTP. */
	dwt_txconfig_t tx_cfg = {
		.PGdly = TC_PGDELAY_CH5,
		.power = tx_power,
	};
	dwt_configuretxrf(&tx_cfg);

    dwt_settxantennadelay(ant_dly);
    dwt_setrxantennadelay(ant_dly);

    LOG_INF("DW1000 ready, DEV_ID 0x%08X, ch%u, ant delay %u, tx power 0x%08X",
	    dwt_readdevid(), dw1000_config.chan, ant_dly,
	    dwt_read32bitreg(TX_POWER_ID));

    /* Let the log thread drain before the role loop takes over —
     * the startup output should not depend on when the first frame
     * arrives. */
	k_msleep(10);

    return  0;
}


int main(void) {
    if (dw1000_setup() != 0) {
        return  -EIO;
    }

#if defined(CONFIG_UWB_ROLE_INITIATOR)
    run_initiator();
#elif defined(CONFIG_UWB_ROLE_RESPONDER)
    run_responder();
#else
#error "No role selected"
#endif

    return 0;
}
```

## src/cmds.c
```c
#include <errno.h>
#include <stdint.h>
#include <stdlib.h>
#include <zephyr/shell/shell.h>

#include "storage.h"

static int parse_u16(const struct shell *sh, const char *arg, uint16_t *out)
{
	char *end;
	unsigned long value = strtoul(arg, &end, 0);

	if (*end != '\0' || value > UINT16_MAX) {
		shell_error(sh, "invalid value: %s", arg);
		return -EINVAL;
	}

	*out = (uint16_t)value;

	return 0;
}

static int cmd_addr(const struct shell *sh, size_t argc, char **argv)
{
	uint16_t value;
	int rc;

	if (argc == 1) {
		shell_print(sh, "address: 0x%04X", storage_get_addr());
		return 0;
	}

	rc = parse_u16(sh, argv[1], &value);
	if (rc != 0) {
		return rc;
	}

	rc = storage_set_addr(value);
	if (rc != 0) {
		shell_error(sh, "storage_set_addr failed: %d", rc);
		return rc;
	}

	shell_print(sh, "address stored: 0x%04X", value);
	shell_print(sh, "takes effect after reboot (address is read once at startup)");

	return 0;
}

static int cmd_antdly(const struct shell *sh, size_t argc, char **argv)
{
	uint16_t value;
	int rc;

	if (argc == 1) {
		shell_print(sh, "antenna delay: %u", storage_get_ant_dly());
		return 0;
	}

	rc = parse_u16(sh, argv[1], &value);
	if (rc != 0) {
		return rc;
	}

	rc = storage_set_ant_dly(value);
	if (rc != 0) {
		shell_error(sh, "storage_set_ant_dly failed: %d", rc);
		return rc;
	}

	shell_print(sh, "antenna delay stored: %u", value);

	return 0;
}

SHELL_CMD_ARG_REGISTER(addr, NULL,
	"Get/set the node's short address (decimal or 0x hex)",
	cmd_addr, 1, 1);

SHELL_CMD_ARG_REGISTER(antdly, NULL,
	"Get/set the antenna delay (decimal or 0x hex)",
	cmd_antdly, 1, 1);
```

## src/deca_port.c
```c
#include <zephyr/kernel.h>
#include <zephyr/drivers/spi.h>
#include <zephyr/drivers/gpio.h>
#include <zephyr/logging/log.h>

#include "deca_device_api.h"

LOG_MODULE_REGISTER(deca_port, LOG_LEVEL_INF);

#define DW1000_NODE DT_NODELABEL(ieee802154)
#define DW_SPI_OP (SPI_WORD_SET(8) | SPI_TRANSFER_MSB | SPI_OP_MODE_MASTER)

/* 8 MHz, straight from the devicetree */
static const struct spi_dt_spec dw_spi_fast =
	SPI_DT_SPEC_GET(DW1000_NODE, DW_SPI_OP);

/* Same node, clocked down. The DW1000 needs a slow SPI clock until
 * the PLL has locked and after wake-up. */
static const struct spi_dt_spec dw_spi_slow = {
	.bus = DEVICE_DT_GET(DT_BUS(DW1000_NODE)),
	.config = SPI_CONFIG_DT(DW1000_NODE, DW_SPI_OP),
	.config.frequency = 2000000,
};

/* The rate currently in use. Starts slow — dwt_initialise() runs
 * before the PLL is up. */
static const struct spi_dt_spec *dw_spi = &dw_spi_slow;

static const struct gpio_dt_spec dw_rst =
	GPIO_DT_SPEC_GET(DW1000_NODE, reset_gpios);

/*
 * Hooks called by the vendor driver.
 */

int readfromspi(uint16 headerLength, const uint8 *headerBuffer,
                uint32 readlength, uint8 *readBuffer)
{
    const struct spi_buf tx_bufs[] = {
        { .buf = (void *)headerBuffer, .len = headerLength },
    };
    const struct spi_buf rx_bufs[] = {
        { .buf = NULL,       .len = headerLength },
        { .buf = readBuffer, .len = readlength   },
    };
    const struct spi_buf_set tx = { .buffers = tx_bufs, .count = 1 };
    const struct spi_buf_set rx = { .buffers = rx_bufs, .count = 2 };

    return spi_transceive_dt(dw_spi, &tx, &rx);
}

int writetospi(uint16 headerLength, const uint8 *headerBuffer,
               uint32 bodylength, const uint8 *bodyBuffer)
{
    const struct spi_buf tx_bufs[] = {
        { .buf = (void *)headerBuffer, .len = headerLength },
        { .buf = (void *)bodyBuffer,   .len = bodylength   },
    };
    const struct spi_buf_set tx = { .buffers = tx_bufs, .count = 2 };

    return spi_write_dt(dw_spi, &tx);
}

void deca_sleep(unsigned int time_ms)
{
    k_msleep(time_ms);
}

decaIrqStatus_t decamutexon(void)
{
    return 0;
}

void decamutexoff(decaIrqStatus_t s)
{
    ARG_UNUSED(s);
}

/*
 * Called from the application.
 */

void port_set_dw1000_slowrate(void)
{
    dw_spi = &dw_spi_slow;
}

void port_set_dw1000_fastrate(void)
{
    dw_spi = &dw_spi_fast;
}

/* RSTn is open-drain: pull low to reset, then release to
 * high-impedance. It must never be driven high. */
void reset_DW1000(void)
{
	gpio_pin_configure_dt(&dw_rst, GPIO_OUTPUT_ACTIVE);
	k_msleep(2);
	gpio_pin_configure_dt(&dw_rst, GPIO_INPUT);
	k_msleep(2);
}

int deca_port_init(void)
{
	if (!spi_is_ready_dt(&dw_spi_fast)) {
		LOG_ERR("SPI bus not ready");
		return -ENODEV;
	}

	if (!gpio_is_ready_dt(&dw_rst)) {
		LOG_ERR("reset GPIO not ready");
		return -ENODEV;
	}

	return 0;
}
```

## src/deca_port.h
```c
#ifndef DECA_PORT_H
#define DECA_PORT_H

/*!
 * @brief Check that the SPI bus and reset GPIO drivers are ready.
 * @return 0 on success, -ENODEV if a driver has not initialised.
 */
int deca_port_init(void);

/*!
 * @brief Pulse the DW1000 reset line.
 *
 * RSTn is open-drain: it is pulled low and then released to
 * high-impedance. It must never be driven high.
 */
void reset_DW1000(void);

/*! @brief Switch the SPI clock to 2 MHz, required before PLL lock. */
void port_set_dw1000_slowrate(void);

/*! @brief Switch the SPI clock to 8 MHz. */
void port_set_dw1000_fastrate(void);

#endif /* DECA_PORT_H */
```

## src/dw1000_config.c
```c
#include "dw1000_config.h"

const dwt_config_t dw1000_config = {
        .chan           = 5,
        .prf            = DWT_PRF_64M,
        .txPreambLength = DWT_PLEN_128,
        .rxPAC          = DWT_PAC8,
        .txCode         = 9,
        .rxCode         = 9,
        .nsSFD          = 0,
        .dataRate       = DWT_BR_6M8,
        .phrMode        = DWT_PHRMODE_STD,
        .sfdTO          = 128 + 8 + 1 - 8,
};
```

## src/dw1000_config.h
```c
#ifndef DW1000_CONFIG_H
#define DW1000_CONFIG_H

#include "deca_device_api.h"

/*! Radio configuration. Fixed by the DWM1001C certification —
 *  see docs/config.md. */
extern const dwt_config_t dw1000_config;

/*! Antenna delay. The OTP value on this batch of modules is 16472;
 *  calibrated at 2 m to 16495, since the measured distance came out
 *  282 mm long. One millimetre of error is about 0.107 units: the
 *  delay enters the result four times and T_prop is halved. */
#define DW1000_ANT_DLY    16433

#endif /* DW1000_CONFIG_H */
```

## src/dw1000_spi.c
```c
#include <zephyr/kernel.h>
#include <zephyr/drivers/spi.h>
#include <zephyr/logging/log.h>
#include "dw1000_spi.h"

LOG_MODULE_REGISTER(dw1000_spi, LOG_LEVEL_INF);

#define DW1000_NODE     DT_NODELABEL(ieee802154)

static const struct spi_dt_spec dw_spi = SPI_DT_SPEC_GET(
        DW1000_NODE,
        SPI_WORD_SET(8) | SPI_TRANSFER_MSB | SPI_OP_MODE_MASTER);

static size_t dw_header(uint8_t *hdr, uint8_t reg, uint16_t off, bool write)
{
    hdr[0] = reg & 0x3F;
    
    if (write) {
        hdr[0] |= 0x80;
    }

    if (off == 0) {
        return 1;
    }
    hdr[0] |= 0x40;

    if (off <= 0x7F) {
        hdr[1] = off & 0x7F;
        return 2;
    }

    hdr[1] = 0x80 | (off & 0x7F);
    hdr[2] = (off >> 7) & 0xFF;
    return 3;
}

int dw1000_spi_init(void)
{
    if (!spi_is_ready_dt(&dw_spi)) {
        LOG_ERR("SPI device not ready");
        return -ENODEV;
    }
    return 0;
}

int dw1000_read(uint8_t reg, uint16_t off, uint8_t *data, size_t len)
{
    uint8_t hdr[3];
    size_t hlen = dw_header(hdr, reg, off, false);

    const struct spi_buf tx_bufs[] = {
        { .buf = hdr, .len = hlen },
    };
    const struct spi_buf rx_bufs[] = {
        { .buf = NULL, .len = hlen },
        { .buf = data, .len = len },
    };
    const struct spi_buf_set tx = { .buffers = tx_bufs, .count = 1 };
    const struct spi_buf_set rx = { .buffers = rx_bufs, .count = 2 };

    return spi_transceive_dt(&dw_spi, &tx, &rx);
}

int dw1000_write(uint8_t reg, uint16_t off, const uint8_t *data, size_t len)
{
    uint8_t hdr[3];
    size_t hlen = dw_header(hdr, reg, off, true);

    const struct spi_buf tx_bufs[] = {
        { .buf = hdr,          .len = hlen },
        { .buf = (void *)data, .len = len },
    };
    const struct spi_buf_set tx = { .buffers = tx_bufs, .count = 2 };

    return spi_write_dt(&dw_spi, &tx);
}
```

## src/dw1000_spi.h
```c
#ifndef DW1000_SPI_H
#define DW1000_SPI_H

#include <stdint.h>
#include <stdbool.h>
#include <stddef.h>

int dw1000_spi_init(void);
int dw1000_read(uint8_t reg, uint16_t off, uint8_t *data, size_t len);
int dw1000_write(uint8_t reg, uint16_t off, const uint8_t *data, size_t len);

#endif /* DW1000_SPI_H */
```

## src/initiator.c
```c
#include <inttypes.h>
#include <stdbool.h>
#include <stdint.h>
#include <sys/errno.h>
#include <zephyr/kernel.h>
#include <zephyr/logging/log.h>
#include <deca_device_api.h>

#include "uwb_radio.h"
#include "uwb_msg.h"
#include "initiator.h"
#include "storage.h"
#include "zephyr/sys/byteorder.h"

LOG_MODULE_REGISTER(initiator, LOG_LEVEL_INF);

/* Gap between exchanges */
#define POLL_INTERVAL_MS    500

/* How many exchanges between summary lines. Read by the HIL gate;
 * see uwb-protocol-slots.md, "Формат лога — контракт с гейтом". */
#define STATS_WINDOW        10

/* Anchors the tag can hear from, in slot order. */
static const uint16_t anchor_addr[3] = {
    UWB_ADDR_A1, UWB_ADDR_A2, UWB_ADDR_A3,
};

static int anchor_index(uint16_t addr)
{
    for (int i = 0; i < 3; i++) {
        if (anchor_addr[i] == addr) {
            return i;
        }
    }

    return -1;
}

void run_initiator(void)
{
    uint8_t buf[64];
    uint16_t len;
    uint8_t seq = 0;
    uint32_t n = 0;
    uint32_t ok = 0;
    uint32_t lost = 0;

    uint16_t ant_dly = storage_get_ant_dly();

    LOG_INF("initiator started, addr 0x%04X", uwb_my_addr);

    /* Per-anchor reply counts. ok alone counts a cycle as good if
     * anyone answered, so a single dead anchor out of three would
     * never show up in it. */
    uint32_t heard[3] = { 0, 0, 0 };

    while (1) {
        struct uwb_msg poll = {
            .hdr = {
                .fc = { UWB_FC0, UWB_FC1 },
                .seq = seq,
                .pan = UWB_PAN,
                .dst = UWB_ADDR_BCAST,
                .src = uwb_my_addr,
            },
            .type = MSG_POLL,
        };

        if (uwb_send((uint8_t *)&poll, sizeof(poll)) != 0) {
            LOG_WRN("poll %u not sent", seq);
            seq++;
            k_msleep(POLL_INTERVAL_MS);
            continue;
        }

        /* Final's own delayed-TX schedule and its poll_tx_ts field
         * both need the full 40 bits, read right after TXFRS so the
         * antenna delay adjustment in dwt_readtxtimestamp() is not
         * lost the way a 32-bit reading would. */
        uint64_t poll_tx_ts = uwb_tx_timestamp();

        bool answered[3] = { false, false, false };
        uint64_t resp_rx_ts[3] = { 0 };
        int n_answered = 0;

         /* One window per anchor slot. dwt_setrxtimeout() takes a
         * duration from the moment the receiver is enabled, not a
         * point on the schedule, so these are the gaps between
         * slots: the first covers Poll to A1's slot, the rest one
         * slot each. */
        static const uint32_t slot_window_uus[3] = {
            2 * SLOT_UUS,   /* 1200: room for A1 to answer */
            SLOT_UUS,       /* 600:  A2 */
            SLOT_UUS,       /* 600:  A3 */
        };

        for (int slot = 0; slot < 3 && n_answered < 3; slot++) {
            int err = uwb_receive(buf, sizeof(buf), &len, slot_window_uus[slot]);

            if (err == -ETIMEDOUT) {
                /* Nobody answered in this window. The next anchor
                 * may still come, so keep going. */
                continue;
            }

            if (err != 0) {
                /* A garbled frame; the window may still hold a
                 * genuine response from another anchor. */
                continue;
            }

            if (len < sizeof(struct uwb_msg)) {
                continue;
            }

            struct uwb_msg *rx = (struct uwb_msg *)buf;

            if (rx->type != MSG_RESPONSE ||
                rx->hdr.seq != seq ||
                rx->hdr.dst != uwb_my_addr) {
                continue;
            }

            int idx = anchor_index(rx->hdr.src);

            if (idx < 0) {
                LOG_WRN("response from unknown addr 0x%04X", rx->hdr.src);
                continue;
            }

            if (answered[idx]) {
                continue;
            }

            /* Latched by the chip at reception; stable until the next
             * dwt_rxenable(), which does not happen before this is read. */
            resp_rx_ts[idx] = uwb_rx_timestamp();
            answered[idx] = true;
            n_answered++;
            LOG_DBG("poll %u: response from 0x%04X (A%d)",
                    seq, rx->hdr.src, idx + 1);
        }

        for (int i = 0; i < 3; i++) {
            if (answered[i]) {
                heard[i]++;
            } else {
                LOG_DBG("poll %u: no response from A%d", seq, i + 1);
            }
        }

        /* Final's slot is counted from the tag's own poll_tx_ts, not
         * from anything an anchor sent — this node has that timestamp
         * already, so the delay is computed the same way responder.c
         * derives its response's transmit time from poll_rx_ts:
         * schedule first, then rebuild the 40-bit timestamp from the
         * scheduled value instead of reading it back after the fact. */
        uint32_t final_tx_time =
            (uint32_t)((poll_tx_ts + ((uint64_t)SLOT_FINAL * UUS_TO_DWT_TIME)) >> 8);

        dwt_setdelayedtrxtime(final_tx_time);

        /* Work out the timestamp the Final will carry.
         *
         * The tag cannot read its own transmit timestamp here — the
         * frame has not gone out yet, and by the time it has, the
         * timestamp would have to be inside it already. Delayed
         * transmission breaks that circle: the moment is scheduled in
         * advance, so it can be computed rather than measured. Same
         * reasoning as resp_tx_ts in responder.c.
         *
         * Three corrections turn the scheduled time into the timestamp
         * the chip will actually record:
         *
         *   & 0xFFFFFFFE  DX_TIME ignores the low 9 bits of the 40-bit
         *                 time. Eight of them were dropped by the >> 8
         *                 above; this clears the ninth. Skip it and the
         *                 timestamp is off by up to 256 ticks, about
         *                 1.2 m of range.
         *
         *   << 8          back to the full 40-bit scale. The cast to
         *                 uint64_t comes first: in 32-bit arithmetic
         *                 the shift would throw away the top byte.
         *
         *   + ant_dly     DX_TIME specifies the RMARKER without the
         *                 antenna delay (UM 3.3), but a timestamp read
         *                 from the chip includes it. Computing one by
         *                 hand means adding it back.
         *
         * This value leaves the node and is used off-board to compute
         * a range, so an error here is silent: the frame is well
         * formed, the arithmetic downstream succeeds, and the answer
         * is simply wrong. */
        uint64_t final_tx_ts = ((uint64_t)(final_tx_time & 0xFFFFFFFEUL) << 8) + ant_dly;

        struct uwb_final_msg final = {
            .msg = {
                .hdr = {
                    .fc = { UWB_FC0, UWB_FC1 },
                    .seq = seq,
                    .pan = UWB_PAN,
                    .dst = UWB_ADDR_BCAST,
                    .src = uwb_my_addr,
                },
                .type = MSG_FINAL,
            },
        };

        sys_put_le40(poll_tx_ts, final.poll_tx_ts);
        sys_put_le40(final_tx_ts, final.final_tx_ts);

        for (int i = 0; i < 3; i++) {
            if (answered[i]) {
                final.anchors[i].addr = anchor_addr[i];
                sys_put_le40(resp_rx_ts[i], final.anchors[i].resp_rx_ts);
            }
            /* Left zeroed otherwise: addr 0x0000 marks a missed slot. */

            LOG_DBG("final %u: A%d addr 0x%04X resp_rx_ts 0x%010" PRIx64,
                    seq, i + 1, final.anchors[i].addr, resp_rx_ts[i]);
        }

        LOG_DBG("final %u: poll_tx_ts 0x%010" PRIx64 ", final_tx_ts 0x%010" PRIx64,
                seq, poll_tx_ts, final_tx_ts);

        if (uwb_send_delayed((uint8_t *)&final, sizeof(final)) != 0) {
            LOG_WRN("final %u not sent", seq);
        }

        n++;
        if (n_answered > 0) {
            ok++;
        } else {
            lost++;
        }

        if ((n % STATS_WINDOW) == 0) {
            LOG_INF("n=%u ok %u lost %u | A1 %u A2 %u A3 %u",
                    n, ok, lost, heard[0], heard[1], heard[2]);
        }

        seq++;
        k_msleep(POLL_INTERVAL_MS);
    }
}
```

## src/initiator.h
```c
#ifndef INITIATOR_H
#define INITIATOR_H

void run_initiator(void);

#endif /* INITIATOR_H */
```

## src/responder.c
```c
#include <stdint.h>
#include <zephyr/kernel.h>
#include <zephyr/logging/log.h>
#include <zephyr/sys/byteorder.h>
#include <deca_device_api.h>

#include "storage.h"
#include "uwb_radio.h"
#include "uwb_msg.h"
#include "responder.h"

/*! Delay from receiving the poll to transmitting the response, in UUS.
 *
 *  This is not a free choice. The responder must have time to read the
 *  RX timestamp, compute the transmit time, build the frame and load
 *  it into the TX buffer before the scheduled moment arrives. Too
 *  short and dwt_starttx() returns DWT_ERROR with HPDWARN set, and no
 *  reply goes out at all.
 *
 *  Too long is not free either: the SS-TWR clock error scales with
 *  T_reply, so every microsecond here shows up in the range estimate
 *  (UM Table 65).
 *
 *  The three anchors share one firmware image and tell their slot
 *  apart by their own short address (SLOT_RESP_A1 / A2 / A3, see
 *  uwb_msg.h), so the delay is looked up once at startup rather than
 *  fixed at compile time. */

/*! Speed of light in air, not in vacuum — the value Decawave use in
 *  their ranging examples. The difference is about 0.03 %, 3 cm
 *  at 100 m. */
#define SPEED_OF_LIGHT  299702547.0

LOG_MODULE_REGISTER(responder, LOG_LEVEL_INF);

void run_responder(void)
{
    uint8_t buf[64];
    uint16_t len;
    uint32_t count = 0;
    uint32_t late = 0;
    uint32_t bad = 0;
    uint32_t other = 0;
    uint32_t finals = 0;
    uint32_t ts_zero = 0;
    uint32_t missed = 0;    /* Final came, but the tag never heard our Response */
    uint32_t resp_dly_uus;

    uint16_t ant_dly = storage_get_ant_dly();

    /* State of the cycle in progress, kept across iterations: the
     * Poll arrives in one pass through the loop and the Final in a
     * later one, so these cannot be locals inside it. cycle_seq is
     * the Poll's sequence number and marks the state valid — a
     * Final carrying a different one belongs to a cycle this anchor
     * missed, and its timestamps must not be paired with ours. */
    bool     cycle_open  = false;
    uint8_t  cycle_seq   = 0;
    uint64_t poll_rx_ts  = 0;
    uint64_t resp_tx_ts  = 0;

    switch (uwb_my_addr) {
    case UWB_ADDR_A1:
        resp_dly_uus = SLOT_RESP_A1;
        break;
    case UWB_ADDR_A2:
        resp_dly_uus = SLOT_RESP_A2;
        break;
    case UWB_ADDR_A3:
        resp_dly_uus = SLOT_RESP_A3;
        break;
    default:
        LOG_ERR("addr 0x%04X matches no anchor slot (A1 0x%04X, A2 0x%04X, A3 0x%04X); "
                "responder not starting",
                uwb_my_addr, UWB_ADDR_A1, UWB_ADDR_A2, UWB_ADDR_A3);
        return;
    }

    LOG_INF("responder started, addr 0x%04X, resp slot delay %u UUS",
            uwb_my_addr, resp_dly_uus);

    while (1) {
        /* No timeout: the responder has nothing else to do. */
        if (uwb_receive(buf, sizeof(buf), &len, 0) != 0) {
            bad++;
            goto next;
        }

        if (len < sizeof(struct uwb_msg)) {
            bad++;
            goto next;
        }

        struct uwb_msg *rx = (struct uwb_msg *)buf;


        if (rx->hdr.dst != uwb_my_addr &&
            rx->hdr.dst != UWB_ADDR_BCAST) {
            other++;
            goto next;
        }

        /* ---- Final: closes the cycle this anchor answered ---- */
        if (rx->type == MSG_FINAL) {
            if (len < sizeof(struct uwb_final_msg)) {
                bad++;
                goto  next;
            }

            if (!cycle_open || rx->hdr.seq != cycle_seq) {
                /* A Final for a cycle whose Poll we never saw, or
                 * whose Response never went out. Its timestamps
                 * cannot be paired with ours. */
                other++;
                goto next;
            }

            uint64_t final_rx_ts = uwb_rx_timestamp();

            if (final_rx_ts == 0) {
                ts_zero++;
            }

            finals++;
            cycle_open = false;
            
            struct uwb_final_msg *fin = (struct uwb_final_msg *)buf;

            /* Find our own entry by address, not by slot index: the
             * tag fills the entries of anchors it heard and leaves
             * the others zeroed. */
            int me = -1;

            for (int i = 0; i < 3; i++) {
                if (sys_get_le16((uint8_t *)&fin->anchors[i].addr) == uwb_my_addr) {
                    me = i;
                    break;
                }
            }

            if (me < 0) {
                missed++;
                goto next;
            }

            uint64_t poll_tx_ts = sys_get_le40(fin->poll_tx_ts);
            uint64_t resp_rx_ts = sys_get_le40(fin->anchors[me].resp_rx_ts);
            uint64_t final_tx_ts = sys_get_le40(fin->final_tx_ts);

            /* Four intervals, each measured by one clock only (UM 12.3.2,
             * Decawave ex_05b). Subtracted in 32 bits on purpose: the
             * 40-bit counter wraps every ~17 s, and unsigned 32-bit
             * arithmetic works modulo 2^32, so a wrap between two
             * timestamps of the same cycle (3 ms apart) is harmless. */
            uint32_t ra = (uint32_t)resp_rx_ts  - (uint32_t)poll_tx_ts;   /* tag:    round 1 */
            uint32_t db = (uint32_t)resp_tx_ts  - (uint32_t)poll_rx_ts;   /* anchor: reply 1 */
            uint32_t rb = (uint32_t)final_rx_ts - (uint32_t)resp_tx_ts;   /* anchor: round 2 */
            uint32_t da = (uint32_t)final_tx_ts - (uint32_t)resp_rx_ts;   /* tag:    reply 2 */

            /* double, not float: Ra*Rb is around 4e16, and a 24-bit
             * float mantissa would lose the difference entirely. */
            double tof_dtu = ((double)ra * rb - (double)da * db)
                           / ((double)ra + rb + da + db);

             int32_t d_mm = (int32_t)(tof_dtu * DWT_TIME_UNITS * SPEED_OF_LIGHT * 1000.0);

             /* Self-check. resp_tx_ts was computed in advance from the
             * scheduled time (mask, shift, antenna delay); by now the
             * Response has gone out and the chip holds the real value.
             * They must agree. A nonzero difference means one of the
             * three corrections is wrong. */
            int32_t tx_check = (int32_t)((uint32_t)uwb_tx_timestamp() - (uint32_t)resp_tx_ts);

            LOG_INF("range seq %u: %d mm  tx_check %d", rx->hdr.seq, d_mm, tx_check);

            goto next;

        }

        /* ---- Poll: opens a cycle ---- */
        if (rx->type != MSG_POLL) {
            other++;
            goto next;
        }
        /* Full 40 bits: the addition below would overflow in 32,
		 * and DX_TIME needs bits 8..39 after the shift. */
        poll_rx_ts = uwb_rx_timestamp();

        uint32_t tx_time = (poll_rx_ts + (resp_dly_uus * UUS_TO_DWT_TIME)) >> 8;

        dwt_setdelayedtrxtime(tx_time);

        /* Same three corrections as final_tx_ts in initiator.c: mask
         * the ninth ignored bit, back to the 40-bit scale, then add
         * the antenna delay DX_TIME leaves out (UM 3.3). */
        resp_tx_ts = ((uint64_t)(tx_time & 0xFFFFFFFEUL) << 8) + ant_dly;

        struct uwb_msg reply = {
            .hdr = {
                .fc = { UWB_FC0, UWB_FC1 },
                .seq = rx->hdr.seq,
                .pan = UWB_PAN,
                .dst = rx->hdr.src,
                .src = uwb_my_addr,
            },
            .type = MSG_RESPONSE,
        };

        if (uwb_send_delayed((uint8_t *)&reply, sizeof(reply)) != 0) {
            late++;
            LOG_WRN("delayed TX failed, poll %u (%u late)",
                    rx->hdr.seq, late);
            goto next;
        }

        cycle_seq  = rx->hdr.seq;
        cycle_open = true;
        count++;

        if ((count % 20) == 0) {
            LOG_INF("replies: %u, late %u, bad %u, other %u",
                    count, late, bad, other);
            LOG_INF("finals: %u, ts_zero %u, missed %u",
                    finals, ts_zero, missed);
        }
next:
        /* Give the log thread a slot. Safe here: the reply is
         * already on air, so nothing time-critical is pending. */
        k_msleep(1);
    }
}
```

## src/responder.h
```c
#ifndef RESPONDER_H
#define RESPONDER_H

void run_responder();

#endif /* RESPONDER_H */
```

## src/storage.c
```c
#include <stdint.h>
#include <zephyr/kernel.h>
#include <zephyr/device.h>
#include <zephyr/drivers/flash.h>
#include <zephyr/storage/flash_map.h>
#include <zephyr/kvss/nvs.h>
#include <zephyr/logging/log.h>

#include "storage.h"
#include "dw1000_config.h"
#include "uwb_msg.h"

LOG_MODULE_REGISTER(storage, LOG_LEVEL_INF);

/* The partition comes from the board devicetree: 24 KB at 0x7A000. */
#define NVS_PARTITION         storage_partition
#define NVS_PARTITION_DEVICE  PARTITION_DEVICE(NVS_PARTITION)
#define NVS_PARTITION_OFFSET  PARTITION_OFFSET(NVS_PARTITION)

/* Keys. Never reuse a number for a different meaning — old records
 * with that id may still be on the flash. */
#define ID_ANT_DLY  1
#define ID_ADDR     2

static struct nvs_fs fs;

int storage_init(void)
{
    struct flash_pages_info info;
    int rc;

    fs.flash_device = NVS_PARTITION_DEVICE;

    if (!device_is_ready(fs.flash_device)) {
        LOG_ERR("flash device not ready");
        return -ENODEV;
    }

    fs.offset = NVS_PARTITION_OFFSET;

    rc = flash_get_page_info_by_offs(fs.flash_device, fs.offset, &info);
    if (rc) {
        LOG_ERR("cannot read flash page info: %d", rc);
        return rc;
    }

    fs.sector_size = info.size;
    fs.sector_count = 3U;

    rc = nvs_mount(&fs);
    if (rc) {
        LOG_ERR("nvs_mount failed: %d", rc);
        return  rc;
    }

    LOG_INF("NVS mounted, %u sectors of %u bytes", fs.sector_count, fs.sector_size);

    return 0;
}

uint16_t storage_get_ant_dly(void)
{
    uint16_t value;
    int rc;

    rc = nvs_read(&fs, ID_ANT_DLY, &value, sizeof(value));

    /* nvs_read returns the number of bytes read, or a negative
	 * errno; -ENOENT means the key has never been written. */
    if (rc == sizeof(value)) {
        return  value;
    }

    LOG_WRN("no stored antenna delay, using default %u", DW1000_ANT_DLY);

    return DW1000_ANT_DLY;
}

int storage_set_ant_dly(uint16_t value)
{
    int rc = nvs_write(&fs, ID_ANT_DLY, &value, sizeof(value));

    /* nvs_write returns the number of bytes written, 0 if the value
	 * was already there, or a negative errno. */
    if (rc < 0) {
        LOG_ERR("cannot stored antenna delay: %d", rc);
        return rc;
    }

    LOG_INF("antenna delay stored: %u", value);

    return 0;
}

uint16_t storage_get_addr(void)
{
    uint16_t value;
    int rc;
    uint16_t default_addr;

#if defined(CONFIG_UWB_ROLE_INITIATOR)
    default_addr = UWB_ADDR_T1;
#elif defined(CONFIG_UWB_ROLE_RESPONDER)
    default_addr = UWB_ADDR_A1;
#endif

    rc = nvs_read(&fs, ID_ADDR, &value, sizeof(value));

    /* nvs_read returns the number of bytes read, or a negative
	 * errno; -ENOENT means the key has never been written. */
    if (rc == sizeof(value)) {
        return  value;
    }

    LOG_WRN("no stored address, using default 0x%04X", default_addr);

    return default_addr;
}

int storage_set_addr(uint16_t value)
{
    int rc = nvs_write(&fs, ID_ADDR, &value, sizeof(value));

    /* nvs_write returns the number of bytes written, 0 if the value
	 * was already there, or a negative errno. */
    if (rc < 0) {
        LOG_ERR("cannot store address: %d", rc);
        return rc;
    }

    LOG_INF("address stored: 0x%04X", value);

    return 0;
}
```
